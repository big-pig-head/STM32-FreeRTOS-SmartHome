/**
 * Encoding:GB2312
 * 文件功能：蜂鸣器音乐播放（非阻塞版，TIM2 PWM 驱动）
 **/

#include "stm32f10x.h"                  // Device header
#include "Buzzer.H"
#include "stm32f10x.h"           
#include "Delay.h"
#include "OLED.h"
#include "FreeRTOS.h"                   // FreeRTOS 内核（xTaskGetTickCount 计时用）
#include "task.h"                       // 任务相关接口



int i,time,j,a[]={                                                           
		    1635,1376, 917,1376,2062,1836,1635, 917,1376,1376,1836, 917,1376,1376,
		     917,1456, 917,1635,1376, 917,1376,2062,1836,1635, 917,1376,1376,1836,
	         917,1376,1376, 917,1836,1376, 917,                             
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			1031,1635,1456,1376,1226,1092,1226,30,1092,1376                   
		  };

int tm[]={                                                  
		  50, 50, 50, 50, 50, 25, 25, 50, 50, 50, 50, 50, 50, 50,
	      50, 50, 50, 50, 50, 50, 50, 50, 25, 25, 50, 50, 50, 50,
	      50, 50, 50, 50, 25, 25, 50,                       
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		  50, 50, 50, 50, 50, 50,100, 20, 50,200,            
		};


/* ============================================================
 * 非阻塞播放（新增，替代阻塞式 B_Music()）
 * 蜂鸣器发声由 TIM2 PWM 硬件持续输出：Sound_SetHZ 设好频率后，
 * TIM2 自己输出方波驱动蜂鸣器，CPU 无需等待它响完。
 * 因此播放用系统 tick 计时驱动音符切换，任务不再阻塞。
 * ============================================================ */
uint8_t  music_idx      = 0;    /* 当前音符下标(0~246) */
uint8_t  music_phase    = 0;    /* 0=正在发声  1=音符间停顿 */
uint32_t music_end_tick = 0;    /* 当前阶段结束时刻(单位ms) */
uint8_t  music_started  = 0;    /* 播放是否已初始化(供 PlayMusic_task 判断) */

/* 开始/恢复播放：初始化TIM2并播第一个音符 */
void Music_Play_Start(void)
{
	extern uint8_t MusicState;                  /* 引用 Buzzer.c 的全局播放状态 */
	Music_init();                               /* 初始化 TIM2 PWM(配置PA0输出+定时器) */
	music_idx     = 0;                          /* 从第一个音符开始 */
	music_phase   = 0;                          /* 先进入"发声"阶段 */
	music_started = 1;                          /* 标记已初始化 */
	MusicState    = 1;                          /* 置为播放中 */
	Sound_SetHZ(a[0]);                          /* 设第一个音符频率(TIM2 开始发声) */
	music_end_tick = xTaskGetTickCount() + (uint32_t)(tm[0]/25*180);   /* 第一个音符结束时刻 */
}

/* 驱动非阻塞播放状态机：每10ms调用一次，任务不阻塞 */
void Music_Play_Process(void)
{
	extern uint8_t MusicState;                  /* 引用播放状态 */
	if(MusicState != 1) return;                 /* 非播放中直接返回，不阻塞 */
	uint32_t now = xTaskGetTickCount();         /* 当前系统 tick(ms) */  //这个就是读取现在硬件定时器的
												//**tick（时钟节拍 / 心跳）是 FreeRTOS 的系统时钟单位。** 系统里有一个硬件定时器（SysTick），每隔固定时间（通常 1ms）产生一次中断，tick 数就 +1。于是系统有了一个 "运行了多久" 的计数器。
	if(now < music_end_tick) return;            /* 本阶段还没到点，无需处理 */
	if(music_phase == 0)
	{
		/* 当前音符发声结束 -> 进入停顿(静音) */
		Sound_SetHZ(20);                        /* 设低频(静音/停顿) */
		music_phase = 1;
		uint8_t c = 5;                          /* 默认停顿5ms */
		if(music_idx==49||music_idx==67||music_idx==178) c=0;   /* 这3个音符无停顿 */
		music_end_tick = now + c;
	}
	else
	{
		/* 停顿结束 -> 切到下一个音符 */
		music_idx++;
		if(music_idx > 246)
		{
			/* 整曲播完 */
			MusicState    = 0;                  /* 置空闲 */
			music_started = 0;
			Stop_Music();                       /* 关 TIM2，停 PWM */
		}
		else
		{
			Sound_SetHZ(a[music_idx]);          /* 切到下一个音符频率 */
			music_phase = 0;                    /* 进入"发声"阶段 */
			music_end_tick = now + (uint32_t)(tm[music_idx]/25*180);   /* 该音符持续时长 */
		}
	}
}

